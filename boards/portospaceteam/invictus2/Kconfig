## boards/portospaceteam/invictus2/Kconfig
```kconfig
config BOARD_INV2_NAV
    bool "invictus 2 navigation board"
    select SOC_RP2040
    select RP2_FLASH_W25Q080

config BOARD_INV2_OBC
    bool "invictus 2 on board computer"
    select SOC_RP2040
    select RP2_FLASH_W25Q080

config BOARD_INV2_HYDRA
    bool "invictus 2 hydraulic regulation and actuation"
    select SOC_RP2040
    select RP2_FLASH_W25Q080

config BOARD_INV2_PSAT
    bool "invictus 2 pocket sat"
    select SOC_RP2040
    select RP2_FLASH_W25Q080
```

## boards/portospaceteam/invictus2/Kconfig.defconfig
```kconfig
if (BOARD_INV2_OBC || BOARD_INV2_NAV || BOARD_INV2_TVCS)

if I2C_DW

config I2C_DW_CLOCK_SPEED
	default 125

endif # I2C_DW

config USB_SELF_POWERED
	default n

endif # BOARD_INV2_OBC || BOARD_INV2_NAV || BOARD_INV2_TVCS
```

## boards/portospaceteam/invictus2/board.yml
```yaml
boards:
- name: inv2_obc
  full_name: Invictus2.0 On Board Computer
  vendor: portospaceteam
  socs:
  - name: rp2040

- name: inv2_nav
  full_name: Invictus2.0 Navigator
  vendor: portospaceteam
  socs:
  - name: rp2040

- name: inv2_hydra
  full_name: Invictus2.0 Hydraulic Regulation and Actuation
  vendor: portospaceteam
  socs:
  - name: rp2040

- name: inv2_psat
  full_name: Invictus2.0 Pocket Sat
  vendor: portospaceteam
  socs:
  - name: rp2040
```

## boards/portospaceteam/invictus2/inv2_hydra_rp2040_defconfig
```kconfig
# General
CONFIG_SYS_CLOCK_HW_CYCLES_PER_SEC=125000000
CONFIG_RESET=y
CONFIG_GPIO=y

# Enable UART Driver
CONFIG_SERIAL=y
CONFIG_UART_INTERRUPT_DRIVEN=y

# Enable console
CONFIG_CONSOLE=y
CONFIG_UART_CONSOLE=y

# Enable clock control by default
CONFIG_CLOCK_CONTROL=y

# Target correct flash partition
CONFIG_USE_DT_CODE_PARTITION=y

# UF2 by default. Hex as well
CONFIG_BUILD_OUTPUT_UF2=y
CONFIG_BUILD_OUTPUT_HEX=y
```

## drivers/Kconfig
```kconfig
menu "Drivers"
rsource "lora_sx128x/Kconfig"
rsource "sensor/maxim/max31856/Kconfig"
endmenu
```

## drivers/lora_sx128x/Kconfig
```kconfig
# LoRa Basics Modem drivers configuration options
#
# Copyright (c) 2024 Semtech Corporation - Félix Piédallu
#
# SPDX-License-Identifier: Apache-2.0

menuconfig LORA_SX128X
	bool "Drivers the sx128x Semtech LoRa radios [EXPERIMENTAL]"
	select POLL
	select EXPERIMENTAL
	depends on !LORA
	help
	  Include drivers for the sx128x Semtech LoRa radios. This is an experimental implementation

if LORA_SX128X

module = LORA_SX128X
module-str = lora_sx128x_driver
source "subsys/logging/Kconfig.template.log_config"

rsource "Kconfig.sx128x"

config LORA_SX128X_INIT_PRIORITY
  int "Init priority"
  default 50


config LORA_SX128X_EVENT_TRIGGER
	bool

choice
	prompt "Event trigger mode"
	default LORA_SX128X_EVENT_TRIGGER_GLOBAL_THREAD
	help
	  Specify the type of triggering to be used by the LORA_SX128X driver.

config LORA_SX128X_EVENT_TRIGGER_NONE
	bool "No trigger on event"

config LORA_SX128X_EVENT_TRIGGER_GLOBAL_THREAD
	bool "Use global thread"
	depends on GPIO
	select LORA_SX128X_EVENT_TRIGGER

config LORA_SX128X_EVENT_TRIGGER_OWN_THREAD
	bool "Use own thread"
	depends on GPIO
	select LORA_SX128X_EVENT_TRIGGER

endchoice

config LORA_SX128X_EVENT_TRIGGER_THREAD_PRIORITY
	int "Thread priority"
	depends on LORA_SX128X_EVENT_TRIGGER_OWN_THREAD
	default 10
	help
	  Priority of thread used by the driver to handle interrupts.

config LORA_SX128X_EVENT_TRIGGER_THREAD_STACK_SIZE
	int "Thread stack size"
	depends on LORA_SX128X_EVENT_TRIGGER_OWN_THREAD
	default 1024
	help
	  Stack size of thread used by the driver to handle interrupts.

config LORA_SX128X_HAL_WAIT_ON_BUSY_TIMEOUT_MSEC
	int "Time to wait on BUSY pin in ms before aborting"
	default 600000
	help
	  Busy pin wait time in milliseconds. As WiFi and GPS scanning can take
	  seconds/minutes, the default is set to 10 minutes.


endif # LORA_SX128X
```

## drivers/lora_sx128x/Kconfig.sx128x
```kconfig
# Copyright (c) 2024 Semtech Corporation - Félix Piédallu
# SPDX-License-Identifier: Apache-2.0

# LoRa transceiver drivers configuration options

config SEMTECH_SX128X
	bool "Semtech SX128x family LoRa transceiver driver"
	default y
#	depends on DT_HAS_SEMTECH_SX1280_LORA_ENABLED || DT_HAS_SEMTECH_SX1281_LORA_ENABLED
	select SPI
	help
	  Enable driver for the SX128x family LoRa transceiver driver
```

## drivers/sensor/maxim/max31856/Kconfig
```kconfig
config MAX31856
	bool "MAX31856 sensor"
	default y
	depends on DT_HAS_MAXIM_MAX31856_ENABLED
	select SPI
	help
	  Enable driver for MAX31856 SPI-based precision thermocouple to digital converter with linearization.
```

## dts/bindings/lora_sx128x/semtech,lora-sx1280.yaml
```yaml
description: Semtech SX1280 LoRa radio module

compatible: "semtech,lora-sx1280"

include: semtech,lora-sx128x-common.yaml
```

## dts/bindings/lora_sx128x/semtech,lora-sx128x-common.yaml
```yaml
# Copyright (c) 2024 Semtech Corporation
# SPDX-License-Identifier: Apache-2.0

description: Semtech SX128X LoRa radio module

include: spi-device.yaml

properties:
  reset-gpios:
    type: phandle-array
    required: false
    description: |
      GPIO connected to the radio's NRESET signal.

      This signal is open-drain, active-low as interpreted by the modem.

  busy-gpios:
    type: phandle-array
    required: true
    description: |
      GPIO connected to the radio's BUSY signal.

      This signal is high when the radio is ready to accept commands, and
      low when it is processing a command.

  dio1-gpios:
    type: phandle-array
    required: false
    description: |
      GPIO connected to the radio's DIO1 signal. This GPIO will be used as
      a generic IRQ line from the chip.

  dio2-gpios:
    type: phandle-array
    required: false
    description: |
      GPIO connected to the radio's DIO2 signal. This GPIO will be used as
      a generic IRQ line from the chip.

      Note that this conflicts with dio2-as-rf-switch.

  dio3-gpios:
    type: phandle-array
    required: false
    description: |
      GPIO connected to the radio's DIO3 signal. This GPIO will be used as
      a generic IRQ line from the chip.

      Note that this conflicts with dio3-as-tcxo-enable.
```

## dts/bindings/sensor/maxim,max31856-spi.yaml
```yaml
---

description: |
  MAX31856 Precision Thermocouple to Digital Converter with Linearization

compatible: "maxim,max31856"

include: spi-device.yaml

properties:
  drdy-gpios:
    type: phandle-array
    required: false
    description: |
      GPIO connected to the negated Data Ready output.
      Active Low.

  fault-gpios:
    type: phandle-array
    required: false
    description: |
      GPIO connected to the negated Fault output.
      Represents cable, thermocouple or temperature fault.
      Active low.

  thermocouple-type:
    type: int
    required: true
    enum:
      - 0   # B Type
      - 1   # E Type
      - 2   # J Type
      - 3   # K Type
      - 4   # N Type
      - 5   # R Type
      - 6   # S Type
      - 7   # T Type
      - 8   # VMODE G8
      - 12  # VMODE G32
    description: |
      Select the type of Thermocouple. Order: [B E J K N R S T G8 G32]
      (See include/invictus2/dt-bindings/sensor/maxim/max31856.h)

  filter-50hz:
    type: boolean
    required: false
    description: |
      Enable 50Hz line noise rejection filter. If not set, 60Hz is used.

  averaging-mode:
    type: int
    required: false
    default: 0
    enum:
      - 0  # 1 sample
      - 1  # 2 samples
      - 2  # 4 samples
      - 3  # 8 samples
      - 4  # 16 samples
    description: |
      Select number of samples to average for noise reduction.
      A higher value increases conversion time but reduces noise.
      (See include/invictus2/dt-bindings/sensor/maxim/max31856.h)

  open-circuit-mode:
    type: int
    required: false
    default: 0
    enum:
      - 0  # disabled
      - 1  # Rs < 5k
      - 2  # 5k < Rs < 40k, t < 2ms
      - 3  # 5k < Rs < 40k, t > 2ms
    description: |
      Select open-circuit fault detection mode.
      Runs once every 16 samples if active. Depends on RS and time constant.
      (See include/invictus2/dt-bindings/sensor/maxim/max31856.h)

  cj-offset:
    type: int
    required: false
    default: 0
    description: |
      Offset to apply to cold-junction sensor reading, in steps of 0.0625°C.
      Range: -128 to 127 (signed 8 bit), e.g., offset -2.5°C = -40.
```

## invictus/tests/filling/testcase.yaml
```yaml
common:
  tags: "invictus OBC"
  integration_platforms:
    - qemu_cortex_m0
tests:
  invictus.filling.state_machine: {}
```

## invictus/tests/spi_emul/testcase.yaml
```yaml
tests:
  invictus.spi_emul.base:
    tags:
      - invictus
      - spi_emul
    platform_allow:
      - native_sim
```

## invictus2/obc/tests/lora/unit-testing/testcase.yaml
```yaml
tests:
  # section.subsection
  sample.testing.ztest:
    build_only: false
    platform_allow:
      - native_posix
      - native_sim
    integration_platforms:
      - native_sim
    extra_args:
      - SX128X_FAKE=1
      - EXTRA_DTC_OVERLAY_FILE=../../../../../invictus2/obc/boards/native_sim_native_64.overlay
    tags: test_framework
```

## lib/Kconfig
```kconfig
rsource "modbus/Kconfig"

menu "Invictus2 libcommmon configuration options"

config INVICTUS2_LIBCOMMON
    bool "Enable invictus2 libcommon."
    default y

config INVICTUS2_LIBCOMMON_MODBUS
    bool "enable libcommon modbus module"
    default y
    depends on INVICTUS2_LIBCOMMON

endmenu
```

## lib/modbus/Kconfig
```kconfig
menu "Invictus 2 top level modbus configuration"

if INVICTUS2_LIBCOMMON_MODBUS

# ---- --------------- ----
# ---- General Options ----
# ---- --------------- ----

config MODBUS_REG_MTX_LOCK_TIMEOUT
    int "Timeout for locking modbus reg mutexes (in msec)"
    default 500

# ---- ---------------- ----
# ---- UF Hydra Options ----
# ---- ---------------- ----

config MODBUS_HYDRA_UF_SLAVE_ID
    int "Modbus slave address for the Upper Feed HYDRA"
    default 1

config MODBUS_HYDRA_UF_INPUT_ADDR_START
    int "start address for the UF HYDRA input registers"
    default 0

config MODBUS_HYDRA_UF_COILS_ADDR_START
    int "start address for the UF HYDRA coil registers"
    default 0

# ---- ---------------- ----
# ---- LF Hydra Options ----
# ---- ---------------- ----

config MODBUS_HYDRA_LF_SLAVE_ID
    int "Modbus slave address for the Lower Feed HYDRA"
    default 2

config MODBUS_HYDRA_LF_INPUT_ADDR_START
    int "start address for the LF HYDRA input registers"
    default 0

config MODBUS_HYDRA_LF_COILS_ADDR_START
    int "start address for the LF HYDRA coil registers"
    default 0

# ---- ---------------- ----
# ---- FS Hydra Options ----
# ---- ---------------- ----

config MODBUS_HYDRA_FS_SLAVE_ID
    int "Modbus slave address for the Rocket LIFT"
    default 3

config MODBUS_HYDRA_FS_INPUT_ADDR_START
    int "start address for the LF HYDRA input registers"
    default 0

config MODBUS_HYDRA_FS_COILS_ADDR_START
    int "start address for the LF HYDRA coil registers"
    default 0

# ---- ------------------- ----
# ---- Rocket LIFT Options ----
# ---- ------------------- ----

config MODBUS_ROCKET_LIFT_SLAVE_ID
    int "Modbus slave address for the Rocket LIFT"
    default 4

config MODBUS_ROCKET_LIFT_INPUT_ADDR_START
    int "start address for the Rocket LIFT input registers"
    default 0

config MODBUS_ROCKET_LIFT_COILS_ADDR_START
    int "start address for the Rocket LIFT coil registers"
    default 0

# ---- ------------------- ----
# ---- Rocket LIFT Options ----
# ---- ------------------- ----

config MODBUS_FS_LIFT_SLAVE_ID
    int "Modbus slave address for the Filling Station LIFT"
    default 5

config MODBUS_FS_LIFT_INPUT_ADDR_START
    int "start address for the Filling Station LIFT input registers"
    default 0

config MODBUS_FS_LIFT_COILS_ADDR_START
    int "start address for the Filling Station LIFT coil registers"
    default 0

endif # INVICTUS2_LIBCOMMON

endmenu
```

## test/filling/testcase.yaml
```yaml
tests:
  invictus.filling.state_machine:
    tags:
      - "invictus"
      - "obc"
      - "filling"
    platform_allow:
      - qemu_x86_64
      - qemu_cortex_m0
```

## west.yml
```yaml
---
manifest:
  remotes:
    - name: zephyrproject-rtos
      url-base: https://github.com/zephyrproject-rtos

    - name: lora-net
      url-base: https://github.com/Lora-net

  projects:
    - name: zephyr
      remote: zephyrproject-rtos
      revision: main
      import: true

    # - name: LBM_Zephyr
    #   remote: lora-net
    #   revision: master
    #   import: true
```
