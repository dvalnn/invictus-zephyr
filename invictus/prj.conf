## CMakeLists.txt
```
# SPDX-License-Identifier: Apache-2.0

cmake_minimum_required(VERSION 3.20.0)

find_package(Zephyr REQUIRED HINTS $ENV{ZEPHYR_BASE})
project(invictus)

target_sources(app PRIVATE src/main.c src/filling_sm.c)
```

## prj.conf
```kconfig
# CDC ACM Modbus configuration
CONFIG_UART_LINE_CTRL=y
CONFIG_USB_DEVICE_STACK=y
CONFIG_USB_DEVICE_PRODUCT="Zephyr CDC ACM Modbus Master Invictus"
CONFIG_USB_DEVICE_INITIALIZE_AT_BOOT=n

# Logging settings
CONFIG_LOG=y
CONFIG_LOG_MODE_DEFERRED=y # default mode
CONFIG_LOG_MODE_IMMEDIATE=n
CONFIG_LOG_MODE_MINIMAL=n

# Modbus settings
CONFIG_MODBUS=y
CONFIG_MODBUS_ROLE_CLIENT=y

# rtt settings
CONFIG_UART_CONSOLE=n
CONFIG_RTT_CONSOLE=y
CONFIG_USE_SEGGER_RTT=y

# State Machine Framework settings
CONFIG_SMF=y
CONFIG_SMF_ANCESTOR_SUPPORT=y
CONFIG_SMF_INITIAL_TRANSITION=y
```

## src/main.c
```c
#include <zephyr/kernel.h>
#include <zephyr/modbus/modbus.h>
#include <zephyr/usb/usb_device.h>
#include <zephyr/sys/util.h>

#include "filling_sm.h"

LOG_MODULE_REGISTER(mbs_sample, LOG_LEVEL_INF);

static int client_iface;

const static struct modbus_iface_param client_param = {
	.mode = MODBUS_MODE_RTU,
	.rx_timeout = 50000,
	.serial =
		{
			// TODO: Double check how high the baud rate can be
			.baud = 19200,
			// NOTE: In RTU mode, modbus uses CRC checks, so parity can be NONE
			.parity = UART_CFG_PARITY_NONE,
			.stop_bits_client = UART_CFG_STOP_BITS_1,
		},
};

#define MODBUS_NODE DT_COMPAT_GET_ANY_STATUS_OKAY(zephyr_modbus_serial)

static int init_modbus_master(void)
{
	const char iface_name[] = {DEVICE_DT_NAME(MODBUS_NODE)};
	client_iface = modbus_iface_get_by_name(iface_name);

	if (client_iface < 0) {
		LOG_ERR("Failed to get client_iface index for %s", iface_name);
		return client_iface;
	}

	return modbus_init_client(client_iface, client_param);
}

int main(void)
{

#if DT_NODE_HAS_COMPAT(DT_PARENT(MODBUS_NODE), zephyr_cdc_acm_uart)
	const struct device *const dev = DEVICE_DT_GET(DT_PARENT(MODBUS_NODE));
	uint32_t dtr = 0;

	if (!device_is_ready(dev) || usb_enable(NULL)) {
		return 0;
	}

	while (!dtr) {
		uart_line_ctrl_get(dev, UART_LINE_CTRL_DTR, &dtr);
		k_sleep(K_MSEC(100));
	}

	LOG_INF("Client connected on %s", dev->name);
#endif

	if (init_modbus_master()) {
		LOG_ERR("Modbus RTU client initialization failed");
		return 0;
	}

	const int slave_addr = 0x01;

	DEFAULT_FSM_OBJECT(filling_sm_obj, client_iface);
	filling_sm_init(&filling_sm_obj);

	while (1) {
		k_sleep(K_MSEC(1000)); // For now, looping every second is fine

		// Do modbus stuff here, later we will move this to a separate thread
		//
		if (modbus_read_holding_regs(client_iface, slave_addr, 0, filling_sm_obj.data.raw,
					     ARRAY_SIZE(filling_sm_obj.data.raw)) < 0) {
			LOG_ERR("Failed to read holding registers");
			continue;
		}

		LOG_FILLING_DATA(&filling_sm_obj);

		LOG_HEXDUMP_DBG(filling_sm_obj.data.raw, sizeof(filling_sm_obj.data.raw),
				"Raw holding registers");

		smf_run_state(SMF_CTX(&filling_sm_obj));
	}

	return 0;
}
```

## include/filling_sm.h
```c
#ifndef _FILLING_SM_H_
#define _FILLING_SM_H_

#include <zephyr/smf.h>

#include "filling_sm_config.h"

#define CMD_OTHER_START  0x00010000
#define CMD_IDLE_START   0x00000100
#define CMD_GLOBAL_START 0x00000001

#define CMD_OTHER_MASK  0x00FF0000
#define CMD_IDLE_MASK   0x0000FF00
#define CMD_GLOBAL_MASK 0x000000FF

#define CMD_OTHER(x)  ((x) & CMD_OTHER_MASK)
#define CMD_IDLE(x)   ((x) & CMD_IDLE_MASK)
#define CMD_GLOBAL(x) ((x) & CMD_GLOBAL_MASK)

enum cmd_global {
	CMD_STOP = CMD_GLOBAL_START, // ANY -> IDLE
	CMD_ABORT,                   // ANY -> ABORT
	CMD_PAUSE,                   // ANY -> SAFE_PAUSE_IDLE
};

enum cmd_idle {
	CMD_FILL_COPV = CMD_IDLE_START, // IDLE -> FILLING_COPV_IDLE
	CMD_PRE_PRESSURIZE,             // IDLE -> PRE_PRESSURIZING_IDLE
	CMD_FILL_N20,                   // IDLE -> FILLING_N20_IDLE
	CMD_POST_PRESSURIZE,            // IDLE -> POST_PRESSURIZING_IDLE
};

enum cmd_other {
	CMD_READY = CMD_OTHER_START, // ABORT -> IDLE
	CMD_RESUME,                  // SAFE_PAUSE -> IDLE
};

typedef uint32_t cmd_t;

/* List of possible states */
enum filling_state {
	ROOT, // parent state to all states. Used to handle global commands

	IDLE,
	ABORT,
	MANUAL_OP, // NOTE: Acept manual override commands from the ground station

	// SAFE PAUSE
	SAFE_PAUSE, // parent state
	SAFE_PAUSE_IDLE,
	SAFE_PAUSE_VENT,

	// FILLING_COPV (filling N)
	FILLING_COPV, // parent state
	FILLING_COPV_IDLE,
	FILLING_COPV_FILL,

	// PRE_PRESSURIZING
	PRE_PRESSURIZING, // parent state
	PRE_PRESSURIZING_IDLE,
	PRE_PRESSURIZING_VENT,
	PRE_PRESSURIZING_FILL_N,

	// FILLING_N20
	FILLING_N20, // parent state
	FILLING_N20_IDLE,
	FILLING_N20_FILL,
	FILLING_N20_VENT,

	// POST_PRESSURIZING
	POST_PRESSURIZING, // parent state
	POST_PRESSURIZING_IDLE,
	POST_PRESSURIZING_VENT,
	POST_PRESSURIZING_FILL_N,
};

/* User defined object */
struct filling_sm_object {
	/* This must be first */
	struct smf_ctx ctx;

	cmd_t command;
	int modbus_client_iface;

	union filling_data {
		struct {
			uint16_t pre_tank_pressure;
			uint16_t main_tank_pressure;
			uint16_t main_tank_weight;
			uint16_t main_tank_temperature;
		}; // anonymous struct
		uint16_t raw[4];
	} data;

	struct safe_pause_config {
		uint16_t target_pre_tank_pressure;
		uint16_t trigger_pre_tank_pressure;
	} safe_pause_config;

	// State Machine Configuration
	struct filling_copv_config {
		uint16_t target_pre_tank_pressure;
	} f_copv_config;

	struct pre_pressurizing_config {
		uint16_t target_main_pressure;
		uint16_t trigger_main_pressure;
	} pre_p_config;

	struct filling_n20_config {
		uint16_t target_main_pressure;
		uint16_t target_main_weight;
		uint16_t trigger_main_pressure;
		uint16_t trigger_main_temp;
	} f_n20_config;

	struct post_pressurizing_config {
		uint16_t target_main_pressure;
		uint16_t trigger_main_pressure;
	} post_p_config;
};

#ifdef UNIT_TEST
extern const struct smf_state filling_states[];
#endif

void filling_sm_init(struct filling_sm_object *initial_s_obj);

#define LOG_FILLING_DATA(fsm)                                                                      \
	do {                                                                                       \
		LOG_INF("Pressurizing Tank P: %u", (fsm)->data.pre_tank_pressure);                 \
		LOG_INF("Main Tank P: %u", (fsm)->data.main_tank_pressure);                        \
		LOG_INF("Main Tank W: %u", (fsm)->data.main_tank_weight);                          \
		LOG_INF("Main Tank T: %u", (fsm)->data.main_tank_temperature);                     \
	} while (0)

#define DEFAULT_FSM_OBJECT(name, client_iface)                                                     \
	struct filling_sm_object name = {                                                          \
		.command = 0,                                                                      \
		.modbus_client_iface = client_iface,                                               \
		.data =                                                                            \
			{                                                                          \
				.raw = {0},                                                        \
			},                                                                         \
		.safe_pause_config =                                                               \
			{                                                                          \
				.target_pre_tank_pressure = SAFE_PAUSE_TARGET_PRE_P,               \
				.trigger_pre_tank_pressure = SAFE_PAUSE_TRIGGER_PRE_P,             \
			},                                                                         \
		.f_copv_config =                                                                   \
			{                                                                          \
				.target_pre_tank_pressure = FILLING_COPV_TARGET_PRE_P,             \
			},                                                                         \
		.pre_p_config =                                                                    \
			{                                                                          \
				.target_main_pressure = PRE_PRESSURIZING_TARGET_MAIN_P,            \
				.trigger_main_pressure = PRE_PRESSURIZING_TRIGGER_MAIN_P,          \
			},                                                                         \
		.f_n20_config =                                                                    \
			{                                                                          \
				.target_main_pressure = FILLING_N20_TARGET_MAIN_P,                 \
				.target_main_weight = FILLING_N20_TARGET_MAIN_W,                   \
				.trigger_main_pressure = FILLING_N20_TRIGGER_MAIN_P,               \
				.trigger_main_temp = FILLING_N20_TRIGGER_MAIN_T,                   \
			},                                                                         \
		.post_p_config =                                                                   \
			{                                                                          \
				.target_main_pressure = POST_PRESSURIZING_TARGET_MAIN_P,           \
				.trigger_main_pressure = POST_PRESSURIZING_TRIGGER_MAIN_P,         \
			},                                                                         \
	}

#endif // _FILLING_SM_H_
```

## include/filling_sm_config.h
```c
#ifndef _FILLING_SM_CONFIG_H_
#define _FILLING_SM_CONFIG_H_

// NOTE: Pressures in bar
//       weights in kg
//       temperatures in ºC

// TODO: Set safe pause values
#define SAFE_PAUSE_TARGET_PRE_P  0xF00
#define SAFE_PAUSE_TRIGGER_PRE_P 0xBAD

#define FILLING_COPV_TARGET_PRE_P 200

#define PRE_PRESSURIZING_TARGET_MAIN_P  5
#define PRE_PRESSURIZING_TRIGGER_MAIN_P 7

#define FILLING_N20_TARGET_MAIN_P  35
#define FILLING_N20_TARGET_MAIN_W  7
#define FILLING_N20_TRIGGER_MAIN_P 38
#define FILLING_N20_TRIGGER_MAIN_T 2

#define POST_PRESSURIZING_TARGET_MAIN_P  50
#define POST_PRESSURIZING_TRIGGER_MAIN_P 55

#endif // _FILLING_SM_CONFIG_H_
```

## src/filling_sm.c
```c
#include "filling_sm.h"

#include <zephyr/logging/log.h>

LOG_MODULE_REGISTER(filling_sm, LOG_LEVEL_DBG);

#ifndef UNIT_TEST
/* Forward declaration of state table.
 * If unittesting, the state table is exported from the header file instead.
 */
static const struct smf_state filling_states[];
#endif

static bool transition_global(struct filling_sm_object *s)
{
	enum cmd_global cmd = CMD_GLOBAL(s->command);
	if (!cmd) {
		return false;
	}

	switch (cmd) {
	case CMD_STOP:
		LOG_DBG("Global transition: CMD_STOP -> IDLE");
		smf_set_state(SMF_CTX(s), &filling_states[IDLE]);
		break;

	case CMD_ABORT:
		LOG_DBG("Global transition: CMD_ABORT -> ABORT");
		smf_set_state(SMF_CTX(s), &filling_states[ABORT]);
		break;

	case CMD_PAUSE:
		LOG_DBG("Global transition: CMD_PAUSE -> SAFE_PAUSE");
		smf_set_state(SMF_CTX(s), &filling_states[SAFE_PAUSE]);
		break;
	}

	return true;
}

/* State Callbacks */

static void idle_entry(void *o)
{
	struct filling_sm_object *s = (struct filling_sm_object *)o;
	(void)s; // unused
	LOG_DBG("Entered IDLE state");
	// Do something
	// ...
}

static void idle_run(void *o)
{
	struct filling_sm_object *s = (struct filling_sm_object *)o;
	LOG_DBG("Running IDLE state");

	// Do something
	// ...

	if (transition_global(s)) {
		return;
	}

	enum cmd_idle cmd = CMD_IDLE(s->command);
	if (!cmd) {
		return;
	}

	switch (cmd) {
	case CMD_FILL_COPV:
		LOG_DBG("IDLE state: CMD_FILL_COPV -> FILLING_COPV");
		smf_set_state(SMF_CTX(s), &filling_states[FILLING_COPV]);
		break;
	case CMD_PRE_PRESSURIZE:
		LOG_DBG("IDLE state: CMD_PRE_PRESSURIZE -> PRE_PRESSURIZING");
		smf_set_state(SMF_CTX(s), &filling_states[PRE_PRESSURIZING]);
		break;
	case CMD_FILL_N20:
		LOG_DBG("IDLE state: CMD_FILL_N20 -> FILLING_N20");
		smf_set_state(SMF_CTX(s), &filling_states[FILLING_N20]);
		break;
	case CMD_POST_PRESSURIZE:
		LOG_DBG("IDLE state: CMD_POST_PRESSURIZE -> POST_PRESSURIZING");
		smf_set_state(SMF_CTX(s), &filling_states[POST_PRESSURIZING]);
		break;
	}
}

static void idle_exit(void *o)
{
	struct filling_sm_object *s = (struct filling_sm_object *)o;
	(void)s;
	LOG_DBG("Exiting IDLE state");
	// Do something
	// ...
}

static void abort_entry(void *o)
{
	struct filling_sm_object *s = (struct filling_sm_object *)o;
	(void)s; // unused
	LOG_DBG("Entered ABORT state");
	// Do something
	// ...
}

static void abort_run(void *o)
{
	struct filling_sm_object *s = (struct filling_sm_object *)o;
	LOG_DBG("Running ABORT state");

	// Do something
	// ...

	if (transition_global(s)) {
		return;
	}

	enum cmd_other cmd = CMD_OTHER(s->command);
	if (!cmd) {
		return;
	}

	switch (cmd) {
	case CMD_READY:
		LOG_DBG("ABORT state: CMD_READY -> IDLE");
		smf_set_state(SMF_CTX(s), &filling_states[IDLE]);
		break;

	case CMD_RESUME:
		LOG_DBG("ABORT state: CMD_RESUME (no state change)");
		break;
	}
}

static void abort_exit(void *o)
{
	struct filling_sm_object *s = (struct filling_sm_object *)o;
	(void)s; // unused
	LOG_DBG("Exiting ABORT state");
	// Do something
	// ...
}

static void safe_pause_run(void *o)
{
	struct filling_sm_object *s = (struct filling_sm_object *)o;
	LOG_DBG("Running SAFE_PAUSE state");

	// Do something
	// ...

	if (transition_global(s)) {
		return;
	}

	enum cmd_other cmd = CMD_OTHER(s->command);
	if (!cmd) {
		return;
	}

	switch (cmd) {
	case CMD_READY:
		LOG_DBG("SAFE_PAUSE state: CMD_READY (no state change)");
		break;
	case CMD_RESUME:
		LOG_DBG("SAFE_PAUSE state: CMD_RESUME -> IDLE");
		smf_set_state(SMF_CTX(s), &filling_states[IDLE]);
		break;
	}
}

static void safe_pause_idle_run(void *o)
{
	struct filling_sm_object *s = (struct filling_sm_object *)o;
	LOG_DBG("Running SAFE_PAUSE_IDLE state");

	// Do something
	// ...

	if (transition_global(s)) {
		return;
	}

	if (s->data.fields.n_pressure > s->s_p_config.trigger_np) {
		LOG_DBG("SAFE_PAUSE_IDLE: data.fields.n_pressure (%d) > trigger_np (%d) -> "
			"SAFE_PAUSE_VENT",
			s->data.fields.n_pressure, s->s_p_config.trigger_np);
		smf_set_state(SMF_CTX(s), &filling_states[SAFE_PAUSE_VENT]);
	}
}

static void safe_pause_vent_run(void *o)
{
	struct filling_sm_object *s = (struct filling_sm_object *)o;
	LOG_DBG("Running SAFE_PAUSE_VENT state");

	// Do something
	// ...

	if (transition_global(s)) {
		return;
	}

	if (s->data.fields.n_pressure <= s->s_p_config.target_np) {
		LOG_DBG("SAFE_PAUSE_VENT: data.fields.n_pressure (%d) <= target_np (%d) -> "
			"SAFE_PAUSE_IDLE",
			s->data.fields.n_pressure, s->s_p_config.target_np);
		smf_set_state(SMF_CTX(s), &filling_states[SAFE_PAUSE_IDLE]);
	}
}

static void filling_copv_run(void *o)
{
	struct filling_sm_object *s = (struct filling_sm_object *)o;
	(void)s;
	LOG_DBG("Running FILLING_COPV state");
	// Do something
	// ...
}

static void filling_copv_idle_run(void *o)
{
	struct filling_sm_object *s = (struct filling_sm_object *)o;
	LOG_DBG("Running FILLING_COPV_IDLE state");

	// Do something
	// ...

	if (transition_global(s)) {
		return;
	}

	if (s->data.fields.n_pressure <= s->f_copv_config.target_np) {
		LOG_DBG("FILLING_COPV_IDLE: data.fields.n_pressure (%d) <= target_np (%d) -> "
			"FILLING_COPV_FILL",
			s->data.fields.n_pressure, s->f_copv_config.target_np);
		smf_set_state(SMF_CTX(s), &filling_states[FILLING_COPV_FILL]);
	}
}

static void filling_copv_fill_run(void *o)
{
	struct filling_sm_object *s = (struct filling_sm_object *)o;
	LOG_DBG("Running FILLING_COPV_FILL state");

	// Do something
	// ...

	if (transition_global(s)) {
		return;
	}

	if (s->data.fields.n_pressure >= s->f_copv_config.target_np) {
		LOG_DBG("FILLING_COPV_FILL: data.fields.n_pressure (%d) >= target_np (%d) -> "
			"FILLING_COPV_IDLE",
			s->data.fields.n_pressure, s->f_copv_config.target_np);
		smf_set_state(SMF_CTX(s), &filling_states[FILLING_COPV_IDLE]);
	}
}

static void pre_pressurizing_run(void *o)
{
	struct filling_sm_object *s = (struct filling_sm_object *)o;
	(void)s;
	LOG_DBG("Running PRE_PRESSURIZING state");
	// Do something
	// ...
}

static void pre_pressurizing_idle_run(void *o)
{
	struct filling_sm_object *s = (struct filling_sm_object *)o;
	LOG_DBG("Running PRE_PRESSURIZING_IDLE state");

	// Do something
	// ...

	if (transition_global(s)) {
		return;
	}

	// TODO: Double check this condition
	if (s->data.fields.n_pressure > s->pre_p_config.trigger_n2op) {
		LOG_DBG("PRE_PRESSURIZING_IDLE: data.fields.n_pressure (%d) > trigger_n2op (%d) -> "
			"PRE_PRESSURIZING_VENT",
			s->data.fields.n_pressure, s->pre_p_config.trigger_n2op);
		smf_set_state(SMF_CTX(s), &filling_states[PRE_PRESSURIZING_VENT]);
		return;
	}

	if (s->data.fields.n2o_pressure < s->pre_p_config.target_n2op) {
		LOG_DBG("PRE_PRESSURIZING_IDLE: data.fields.n2o_pressure (%d) < target_n2op (%d) "
			"-> "
			"PRE_PRESSURIZING_FILL_N",
			s->data.fields.n2o_pressure, s->pre_p_config.target_n2op);
		smf_set_state(SMF_CTX(s), &filling_states[PRE_PRESSURIZING_FILL_N]);
	}
}

static void pre_pressurizing_fill_run(void *o)
{
	struct filling_sm_object *s = (struct filling_sm_object *)o;
	LOG_DBG("Running PRE_PRESSURIZING_FILL_N state");

	// Do something
	// ...

	if (transition_global(s)) {
		return;
	}

	if (s->data.fields.n2o_pressure >= s->pre_p_config.target_n2op) {
		LOG_DBG("PRE_PRESSURIZING_FILL_N: data.fields.n2o_pressure (%d) >= target_n2op "
			"(%d) -> "
			"PRE_PRESSURIZING_IDLE",
			s->data.fields.n2o_pressure, s->pre_p_config.target_n2op);
		smf_set_state(SMF_CTX(s), &filling_states[PRE_PRESSURIZING_IDLE]);
	}
}

static void pre_pressurizing_vent_run(void *o)
{
	struct filling_sm_object *s = (struct filling_sm_object *)o;
	LOG_DBG("Running PRE_PRESSURIZING_VENT state");

	// Do something
	// ...

	if (transition_global(s)) {
		return;
	}

	// TODO: Double check this condition
	if (s->data.fields.n_pressure <= s->pre_p_config.target_n2op) {
		LOG_DBG("PRE_PRESSURIZING_VENT: data.fields.n_pressure (%d) <= target_n2op (%d) -> "
			"PRE_PRESSURIZING_IDLE",
			s->data.fields.n_pressure, s->pre_p_config.target_n2op);
		smf_set_state(SMF_CTX(s), &filling_states[PRE_PRESSURIZING_IDLE]);
	}
}

static void filling_n20_run(void *o)
{
	struct filling_sm_object *s = (struct filling_sm_object *)o;
	(void)s;
	LOG_DBG("Running FILLING_N20 state");
	// Do something
	// ...
}

static void filling_n20_idle_run(void *o)
{
	struct filling_sm_object *s = (struct filling_sm_object *)o;
	LOG_DBG("Running FILLING_N20_IDLE state");

	// Do something
	// ...

	if (transition_global(s)) {
		return;
	}

	if (s->data.fields.n2o_weight < s->f_n20_config.target_weight) {
		LOG_DBG("FILLING_N20_IDLE: data.fields.n2o_weight (%d) < target_weight (%d) -> "
			"FILLING_N20_FILL",
			s->data.fields.n2o_weight, s->f_n20_config.target_weight);
		smf_set_state(SMF_CTX(s), &filling_states[FILLING_N20_FILL]);
	}
}

static void filling_n20_fill_run(void *o)
{
	struct filling_sm_object *s = (struct filling_sm_object *)o;
	LOG_DBG("Running FILLING_N20_FILL state");

	// Do something
	// ...

	if (transition_global(s)) {
		return;
	}

	if (s->data.fields.n2o_pressure >= s->f_n20_config.trigger_n2op &&
	    s->data.fields.temperature > s->f_n20_config.trigger_temp) {
		LOG_DBG("FILLING_N20_FILL: Conditions met (data.fields.n2o_pressure=%d, "
			"data.fields.temperature=%d) -> "
			"FILLING_N20_VENT",
			s->data.fields.n2o_pressure, s->data.fields.temperature);
		smf_set_state(SMF_CTX(s), &filling_states[FILLING_N20_VENT]);
		return;
	}

	if (s->data.fields.n2o_weight >= s->f_n20_config.target_weight) {
		LOG_DBG("FILLING_N20_FILL: data.fields.n2o_weight (%d) >= target_weight (%d) -> "
			"FILLING_N20_IDLE",
			s->data.fields.n2o_weight, s->f_n20_config.target_weight);
		smf_set_state(SMF_CTX(s), &filling_states[FILLING_N20_IDLE]);
	}
}

static void filling_n20_vent_run(void *o)
{
	struct filling_sm_object *s = (struct filling_sm_object *)o;
	LOG_DBG("Running FILLING_N20_VENT state");

	// Do something
	// ...

	if (transition_global(s)) {
		return;
	}

	if (s->data.fields.n2o_pressure <= s->f_n20_config.target_n2op ||
	    s->data.fields.temperature <= s->f_n20_config.trigger_temp) {
		LOG_DBG("FILLING_N20_VENT: Conditions met (data.fields.n2o_pressure=%d, "
			"data.fields.temperature=%d) -> "
			"FILLING_N20_FILL",
			s->data.fields.n2o_pressure, s->data.fields.temperature);
		smf_set_state(SMF_CTX(s), &filling_states[FILLING_N20_FILL]);
	}
}

static void post_pressurizing_run(void *o)
{
	struct filling_sm_object *s = (struct filling_sm_object *)o;
	(void)s;
	LOG_DBG("Running POST_PRESSURIZING state");
	// Do something
	// ...
}

static void post_pressurizing_idle_run(void *o)
{
	struct filling_sm_object *s = (struct filling_sm_object *)o;
	LOG_DBG("Running POST_PRESSURIZING_IDLE state");

	// Do something
	// ...

	if (transition_global(s)) {
		return;
	}

	if (s->data.fields.n_pressure > s->post_p_config.trigger_n2op) {
		LOG_DBG("POST_PRESSURIZING_IDLE: data.fields.n_pressure (%d) > trigger_n2op (%d) "
			"-> "
			"POST_PRESSURIZING_VENT",
			s->data.fields.n_pressure, s->post_p_config.trigger_n2op);
		smf_set_state(SMF_CTX(s), &filling_states[POST_PRESSURIZING_VENT]);
		return;
	}

	if (s->data.fields.n2o_pressure < s->post_p_config.target_n2op) {
		LOG_DBG("POST_PRESSURIZING_IDLE: data.fields.n2o_pressure (%d) < target_n2op (%d) "
			"-> "
			"POST_PRESSURIZING_FILL_N",
			s->data.fields.n2o_pressure, s->post_p_config.target_n2op);
		smf_set_state(SMF_CTX(s), &filling_states[POST_PRESSURIZING_FILL_N]);
	}
}

static void post_pressurizing_fill_run(void *o)
{
	struct filling_sm_object *s = (struct filling_sm_object *)o;
	LOG_DBG("Running POST_PRESSURIZING_FILL_N state");

	// Do something
	// ...

	if (transition_global(s)) {
		return;
	}

	if (s->data.fields.n2o_pressure >= s->post_p_config.target_n2op) {
		LOG_DBG("POST_PRESSURIZING_FILL_N: data.fields.n2o_pressure (%d) >= target_n2op "
			"(%d) -> "
			"POST_PRESSURIZING_IDLE",
			s->data.fields.n2o_pressure, s->post_p_config.target_n2op);
		smf_set_state(SMF_CTX(s), &filling_states[POST_PRESSURIZING_IDLE]);
	}
}

static void post_pressurizing_vent_run(void *o)
{
	struct filling_sm_object *s = (struct filling_sm_object *)o;
	LOG_DBG("Running POST_PRESSURIZING_VENT state");

	// Do something
	// ...

	if (transition_global(s)) {
		return;
	}

	if (s->data.fields.n_pressure <= s->post_p_config.target_n2op) {
		LOG_DBG("POST_PRESSURIZING_VENT: data.fields.n_pressure (%d) <= target_n2op (%d) "
			"-> "
			"POST_PRESSURIZING_IDLE",
			s->data.fields.n_pressure, s->post_p_config.target_n2op);
		smf_set_state(SMF_CTX(s), &filling_states[POST_PRESSURIZING_IDLE]);
	}
}

#ifdef UNIT_TEST
const struct smf_state filling_states[] = {
#else
static const struct smf_state filling_states[] = {
#endif
	// clang-format off
    // SMF_CREATE_STATE(s_entry_cb, s_run_cb, s_exit_cb, s_parent, s_initial_o),
    [IDLE]      = SMF_CREATE_STATE(idle_entry, idle_run, idle_exit, NULL, NULL),
    [ABORT]     = SMF_CREATE_STATE(abort_entry, abort_run, abort_exit, NULL, NULL),
    [MANUAL_OP] = SMF_CREATE_STATE(NULL, NULL, NULL, NULL, NULL), // TODO

    [SAFE_PAUSE]        = SMF_CREATE_STATE(NULL, safe_pause_run, NULL, NULL, &filling_states[SAFE_PAUSE_IDLE]),
    [SAFE_PAUSE_IDLE]   = SMF_CREATE_STATE(NULL, safe_pause_idle_run, NULL, &filling_states[SAFE_PAUSE], NULL),
    [SAFE_PAUSE_VENT]   = SMF_CREATE_STATE(NULL, safe_pause_vent_run, NULL, &filling_states[SAFE_PAUSE], NULL),

    [FILLING_COPV]      = SMF_CREATE_STATE(NULL, filling_copv_run, NULL, NULL, &filling_states[FILLING_COPV_IDLE]),
    [FILLING_COPV_IDLE] = SMF_CREATE_STATE(NULL, filling_copv_idle_run, NULL, &filling_states[FILLING_COPV], NULL),
    [FILLING_COPV_FILL] = SMF_CREATE_STATE(NULL, filling_copv_fill_run, NULL, &filling_states[FILLING_COPV], NULL),

    [PRE_PRESSURIZING]          = SMF_CREATE_STATE(NULL, pre_pressurizing_run, NULL, NULL, &filling_states[PRE_PRESSURIZING_IDLE]),
    [PRE_PRESSURIZING_IDLE]     = SMF_CREATE_STATE(NULL, pre_pressurizing_idle_run, NULL, &filling_states[PRE_PRESSURIZING], NULL),
    [PRE_PRESSURIZING_VENT]     = SMF_CREATE_STATE(NULL, pre_pressurizing_vent_run, NULL, &filling_states[PRE_PRESSURIZING], NULL),
    [PRE_PRESSURIZING_FILL_N]   = SMF_CREATE_STATE(NULL, pre_pressurizing_fill_run, NULL, &filling_states[PRE_PRESSURIZING], NULL),

    [FILLING_N20]       = SMF_CREATE_STATE(NULL, filling_n20_run, NULL, NULL, &filling_states[FILLING_N20_IDLE]),
    [FILLING_N20_IDLE]  = SMF_CREATE_STATE(NULL, filling_n20_idle_run, NULL, &filling_states[FILLING_N20], NULL),
    [FILLING_N20_FILL]  = SMF_CREATE_STATE(NULL, filling_n20_fill_run, NULL, &filling_states[FILLING_N20], NULL),
    [FILLING_N20_VENT]  = SMF_CREATE_STATE(NULL, filling_n20_vent_run, NULL, &filling_states[FILLING_N20], NULL),

    [POST_PRESSURIZING]         = SMF_CREATE_STATE(NULL, post_pressurizing_run, NULL, NULL, &filling_states[POST_PRESSURIZING_IDLE]),
    [POST_PRESSURIZING_IDLE]    = SMF_CREATE_STATE(NULL, post_pressurizing_idle_run, NULL, &filling_states[POST_PRESSURIZING], NULL),
    [POST_PRESSURIZING_VENT]    = SMF_CREATE_STATE(NULL, post_pressurizing_vent_run, NULL, &filling_states[POST_PRESSURIZING], NULL),
    [POST_PRESSURIZING_FILL_N]  = SMF_CREATE_STATE(NULL, post_pressurizing_fill_run, NULL, &filling_states[POST_PRESSURIZING], NULL),
	// clang-format on
};

void filling_sm_init(struct filling_sm_object *initial_s_obj)
{
	LOG_DBG("Initializing state machine: setting initial state to IDLE");
	smf_set_initial(SMF_CTX(initial_s_obj), &filling_states[IDLE]);
}
```

## src/filling_sm.h
```c
#ifndef _FILLING_SM_H_
#define _FILLING_SM_H_

#include <zephyr/kernel.h>
#include <zephyr/smf.h>

#define CMD_OTHER_START  0x00010000
#define CMD_IDLE_START   0x00000100
#define CMD_GLOBAL_START 0x00000001

#define CMD_OTHER_MASK  0x00FF0000
#define CMD_IDLE_MASK   0x0000FF00
#define CMD_GLOBAL_MASK 0x000000FF

#define CMD_OTHER(x)  ((x) & CMD_OTHER_MASK)
#define CMD_IDLE(x)   ((x) & CMD_IDLE_MASK)
#define CMD_GLOBAL(x) ((x) & CMD_GLOBAL_MASK)

enum cmd_global {
	CMD_STOP = CMD_GLOBAL_START, // ANY -> IDLE
	CMD_ABORT,                   // ANY -> ABORT
	CMD_PAUSE,                   // ANY -> SAFE_PAUSE_IDLE
};

enum cmd_idle {
	CMD_FILL_COPV = CMD_IDLE_START, // IDLE -> FILLING_COPV_IDLE
	CMD_PRE_PRESSURIZE,             // IDLE -> PRE_PRESSURIZING_IDLE
	CMD_FILL_N20,                   // IDLE -> FILLING_N20_IDLE
	CMD_POST_PRESSURIZE,            // IDLE -> POST_PRESSURIZING_IDLE
};

enum cmd_other {
	CMD_READY = CMD_OTHER_START, // ABORT -> IDLE
	CMD_RESUME,                  // SAFE_PAUSE -> IDLE
};

typedef uint32_t cmd_t;

/* List of possible states */
enum filling_state {
	IDLE,
	ABORT,
	MANUAL_OP, // NOTE: Acept manual override commands from the ground station

	// SAFE PAUSE
	SAFE_PAUSE, // parent state
	SAFE_PAUSE_IDLE,
	SAFE_PAUSE_VENT,

	// FILLING_COPV (filling N)
	FILLING_COPV, // parent state
	FILLING_COPV_IDLE,
	FILLING_COPV_FILL,

	// PRE_PRESSURIZING
	PRE_PRESSURIZING, // parent state
	PRE_PRESSURIZING_IDLE,
	PRE_PRESSURIZING_VENT,
	PRE_PRESSURIZING_FILL_N,

	// FILLING_N20
	FILLING_N20, // parent state
	FILLING_N20_IDLE,
	FILLING_N20_FILL,
	FILLING_N20_VENT,

	// POST_PRESSURIZING
	POST_PRESSURIZING, // parent state
	POST_PRESSURIZING_IDLE,
	POST_PRESSURIZING_VENT,
	POST_PRESSURIZING_FILL_N,
};

/* User defined object */
struct filling_sm_object {
	/* This must be first */
	struct smf_ctx ctx;

	// Current command
	cmd_t command;

	// Filling data
	uint16_t n_pressure;
	uint16_t n2o_pressure;
	uint16_t n2o_weight;
	uint16_t temperature;

	struct safe_pause_config {
		uint16_t target_np;
		uint16_t trigger_np;
	} s_p_config;

	// State Machine Configuration
	struct filling_copv_config {
		uint16_t target_np;
	} f_copv_config;

	struct pre_pressurizing_config {
		uint16_t target_n2op;
		uint16_t trigger_n2op;
	} pre_p_config;

	struct filling_n20_config {
		uint16_t target_n2op;
		uint16_t target_weight;
		uint16_t trigger_n2op;
		uint16_t trigger_temp;
	} f_n20_config;

	struct post_pressurizing_config {
		uint16_t target_n2op;
		uint16_t trigger_n2op;
	} post_p_config;
};

void filling_sm_init(struct filling_sm_object *initial_s_obj);

#endif // _FILLING_SM_H_
```
