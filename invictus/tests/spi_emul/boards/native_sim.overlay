/ {
    spi_emul@0 {
        compatible = "zephyr,spi-emul-controller";
        reg = <0 1>; // <-- ✅ required!
        status = "okay";

        #address-cells = <1>;
        #size-cells = <0>;

        fake_sensor: fake_sensor@0 {
            compatible = "zephyr,spi-emul";
            reg = <0>;
            label = "FAKE_SPI_SENSOR";

            status = "okay";
            zephyr,emul = "fake-sensor";  // <-- this makes Zephyr register it as emulator
        };
    };
};
