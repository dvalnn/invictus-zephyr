## CMakeLists.txt
```
# SPDX-License-Identifier: Apache-2.0

cmake_minimum_required(VERSION 3.20.0)

find_package(Zephyr REQUIRED HINTS $ENV{ZEPHYR_BASE})
project(invictus_ground_station)

file(GLOB_RECURSE app_sources ${CMAKE_CURRENT_SOURCE_DIR}/src/*.c)

target_sources(app PRIVATE ${app_sources})
target_include_directories(app PRIVATE ${CMAKE_CURRENT_SOURCE_DIR}/include)
```

## prj.conf
```kconfig
# USB configuration
CONFIG_USB_DEVICE_STACK_NEXT=y
CONFIG_CDC_ACM_SERIAL_INITIALIZE_AT_BOOT=y
CONFIG_CDC_ACM_SERIAL_PRODUCT_STRING="Ground Station USB shell"
CONFIG_SHELL_BACKEND_SERIAL_CHECK_DTR=y
CONFIG_USBD_CDC_ACM_LOG_LEVEL_OFF=y
CONFIG_UART_LINE_CTRL=y
CONFIG_LOG_DEFAULT_LEVEL=1

# Shell configuration
CONFIG_PRINTK=y
CONFIG_SHELL=y
CONFIG_LOG=y
CONFIG_LOG_CMDS=y
CONFIG_INIT_STACKS=y
CONFIG_THREAD_STACK_INFO=y
CONFIG_KERNEL_SHELL=y
CONFIG_THREAD_MONITOR=y
CONFIG_BOOT_BANNER=n
CONFIG_THREAD_NAME=y
CONFIG_DEVICE_SHELL=y
CONFIG_DATE_SHELL=y
CONFIG_THREAD_RUNTIME_STATS=y
CONFIG_THREAD_RUNTIME_STATS_USE_TIMING_FUNCTIONS=y
CONFIG_STATS=y
CONFIG_STATS_SHELL=y
```

## boards/inv2_obc.overlay
```dts
// disable hw flow control
&uart0 {
  /delete-property/ hw-flow-control;
  status = "disabled";
};


// GS is not connected to rs485 bus
&uart1 {
  status = "disabled";
  modbus_uart: modbus0{
    status = "disabled";
  };
};
```

## src/main.c
```c
#include <zephyr/kernel.h>
#include <zephyr/toolchain.h>

#include <zephyr/shell/shell.h>
#include <zephyr/logging/log.h>
#include <zephyr/drivers/uart.h>

LOG_MODULE_REGISTER(app);

static int cmd_gs_reset_usb_boot(const struct shell *sh, size_t argc, char **argv);
SHELL_CMD_ARG_REGISTER(reboot, NULL, "Reboot board into USB MSD boot mode.",
                       cmd_gs_reset_usb_boot, 1, 0);

#ifdef CONFIG_SOC_FAMILY_RPI_PICO
#include <pico/bootrom.h>

static int cmd_gs_reset_usb_boot(const struct shell *sh, size_t argc, char **argv)
{
    ARG_UNUSED(argc);
    ARG_UNUSED(argv);

    shell_print(sh, "Rebooting into MSD boot mode.");
    shell_print(sh, "Mount partition and upload UF2 file.");

    reset_usb_boot(0, 0);
    return 0;
}

#else

static int cmd_gs_reset_usb_boot(const struct shell *sh, size_t argc, char **argv)
{
    ARG_UNUSED(sh);
    ARG_UNUSED(argc);
    ARG_UNUSED(argv);

    LOG_ERROR("Reset into USB boot unsuported");
    return 0;
}

#endif

int main(void)
{
#if DT_NODE_HAS_COMPAT(DT_CHOSEN(zephyr_shell_uart), zephyr_cdc_acm_uart)
    const struct device *dev;
    uint32_t dtr = 0;

    dev = DEVICE_DT_GET(DT_CHOSEN(zephyr_shell_uart));
    if (!device_is_ready(dev))
    {
        k_oops();
    }

    while (!dtr)
    {
        uart_line_ctrl_get(dev, UART_LINE_CTRL_DTR, &dtr);
        k_sleep(K_MSEC(100));
    }
#endif
    return 0;
}
```
