## CMakeLists.txt
```
# SPDX-License-Identifier: Apache-2.0

cmake_minimum_required(VERSION 3.20.0)

find_package(Zephyr REQUIRED HINTS $ENV{ZEPHYR_BASE})
project(invictus_hydra)

file(GLOB_RECURSE app_sources CONFIGURE_DEPENDS ${CMAKE_CURRENT_SOURCE_DIR}/src/*.c)

target_sources(app PRIVATE ${app_sources})
target_include_directories(app PRIVATE ${CMAKE_CURRENT_SOURCE_DIR}/include)
```

## Kconfig
```
# SPDX-License-Identifier: Apache-2.0
source "Kconfig.zephyr"

menu "HYDRA variant selection"

choice HYDRA_VARIANT_CHOICE
    prompt "HYDRA variant"
    default HYDRA_UF
    help
      Select which HYDRA variant is used for this build.
      Exactly one variant must be selected.

config HYDRA_UF
    bool "Upper Feed"

config HYDRA_LF
    bool "Lower Feed"

config HYDRA_FS
    bool "Filling Station"

endchoice

# Optional: string alias with the chosen variant name
config HYDRA_VARIANT
    string "HYDRA (string)"
    default "upper feed" if HYDRA_UF
    default "lower feed" if HYDRA_LF
    default "filling station" if HYDRA_FS
    help
      String representation of the selected HYDRA variant, useful for logs
      or build system conditionals.

endmenu

menu "Common HYDRA configuration options"

config MODBUS_ZBUS_LISTENER_PRIO
    int "zbus priority assigned to the modbus listener callback"
    default 5

config MODBUS_WORK_Q_PRIO
    int "priority for the modbus work queue thread"
    default 5

config MODBUS_WORK_Q_STACK
    int "stack size for the modbus work q, in bytes"
    default 1024

config VALVES_ZBUS_LISTENER_PRIO
    int "zbus priority assigned to the valves listener callback"
    default 5

config VALVES_WORK_Q_PRIO
    int "priority for the valves work queue thread"
    default 5

config VALVES_WORK_Q_STACK
    int "stack size for the valves work q, in bytes"
    default 1024

endmenu
```

## prj.conf
```kconfig
CONFIG_LOG=y
CONFIG_GPIO=y
CONFIG_SERIAL=y
CONFIG_UART_INTERRUPT_DRIVEN=y
CONFIG_UART_LINE_CTRL=n

CONFIG_PWM=y
CONFIG_SENSOR=y
CONFIG_SENSOR_LOG_LEVEL_DBG=y

# Console over RTT
CONFIG_USE_SEGGER_RTT=y
CONFIG_CONSOLE=y
CONFIG_RTT_CONSOLE=y
CONFIG_UART_CONSOLE=n

# Modbus RTU client over serial
CONFIG_MODBUS=y
CONFIG_MODBUS_ROLE_CLIENT=y
```

## boards/rpi_pico.overlay
```dts
&pinctrl {
    pwm_default: pwm_default {
        group1 {
            pinmux = <PWM_2B_P5>;
        };
    };
};

&pwm {
    pinctrl-0 = <&pwm_default>;
    pinctrl-names = "default";
    divider-int-0 = <255>;
    status = "okay";
};
```

## src/main.c
```c
#include <zephyr/kernel.h>
#include <zephyr/devicetree.h>
#include <zephyr/drivers/sensor.h>
#include <zephyr/logging/log.h>

/* #include "valves.h" */
/* #include "pwm.h" */

LOG_MODULE_REGISTER(main, LOG_LEVEL_INF);

const struct device *thermo1 = DEVICE_DT_GET(DT_NODELABEL(thermo1));
const struct device *thermo2 = DEVICE_DT_GET(DT_NODELABEL(thermo2));
const struct device *thermo3 = DEVICE_DT_GET(DT_NODELABEL(thermo3));

/* void setup() */
/* { */
/*     pwm_init(); */
/*     LOG_INF("PWM initialized"); */
/*     int rc = valves_init(); */
/*     if (rc) */
/*     { */
/*         LOG_WRN("Valves init failed: %d", rc); */
/*     } */
/*     else */
/*     { */
/*         LOG_INF("Valves initialized"); */
/*     } */
/* } */

/* void loop() */
/* { */
/*     k_sleep(K_MSEC(MAIN_DELAY)); */
/*     valve_pwm_set_angle(0.0f); */
/*     k_sleep(K_MSEC(MAIN_DELAY)); */
/*     valve_pwm_set_angle(180.0f); */
/* } */

int main(void)
{

    if (!device_is_ready(thermo1))
    {
        LOG_ERR("Thermocouple 1 device not ready");
        return -1;
    }

    if (!device_is_ready(thermo2))
    {
        LOG_ERR("Thermocouple 2 device not ready");
        return -1;
    }

    if (!device_is_ready(thermo3))
    {
        LOG_ERR("Thermocouple 3 device not ready");
        return -1;
    }

    struct sensor_value env_temp1, env_temp2, env_temp3;
    struct sensor_value die_temp1, die_temp2, die_temp3;
    int ret1, ret2, ret3;

    while (1)
    {
        k_sleep(K_MSEC(750));

        ret1 = sensor_sample_fetch(thermo1);
        ret2 = sensor_sample_fetch(thermo2);
        ret3 = sensor_sample_fetch(thermo3);

        if (ret1 == 0)
        {
            sensor_channel_get(thermo1, SENSOR_CHAN_AMBIENT_TEMP, &env_temp1);
            sensor_channel_get(thermo1, SENSOR_CHAN_DIE_TEMP, &die_temp1);
            LOG_INF("T1 | Ambient: %d.%06d °C | Die: %d.%06d °C", env_temp1.val1,
                    env_temp1.val2, die_temp1.val1, die_temp1.val2);
        }
        else
        {
            LOG_ERR("Failed to fetch sample from Thermocouple 1: %d", ret1);
        }

        if (ret2 == 0)
        {
            sensor_channel_get(thermo2, SENSOR_CHAN_AMBIENT_TEMP, &env_temp2);
            sensor_channel_get(thermo2, SENSOR_CHAN_DIE_TEMP, &die_temp2);
            LOG_INF("T2 | Ambient: %d.%06d °C | Die: %d.%06d °C", env_temp2.val1,
                    env_temp2.val2, die_temp2.val1, die_temp2.val2);
        }
        else
        {
            LOG_ERR("Failed to fetch sample from Thermocouple 2: %d", ret2);
        }

        if (ret3 == 0)
        {
            sensor_channel_get(thermo3, SENSOR_CHAN_AMBIENT_TEMP, &env_temp3);
            sensor_channel_get(thermo3, SENSOR_CHAN_DIE_TEMP, &die_temp3);
            LOG_INF("T3 | Ambient: %d.%06d °C | Die: %d.%06d °C", env_temp2.val1,
                    env_temp2.val2, die_temp2.val1, die_temp2.val2);
        }
        else
        {
            LOG_ERR("Failed to fetch sample from Thermocouple 3: %d", ret3);
        }
    }
}
```

## include/data_models.h
```c
#ifndef DATA_MODELS_H
#define DATA_MODELS_H

#include <zephyr/kernel.h>
#include <zephyr/modbus/modbus.h>
#include <zephyr/logging/log.h>

typedef enum {
    SOL_VALVE_1 = 0,
    SOL_VALVE_2,
    SOL_VALVE_3,
    SB_VALVE_1,
    SB_VALVE_2,
    QDC_VALVE_1,
    QDC_VALVE_2,
    SERVO_1,
    VALVE_COUNT
} valve_t;

typedef enum {
    THERMO_1 = 0,
    THERMO_2,
    THERMO_3,
    PRESSURE_1,
    PRESSURE_2,
    PRESSURE_3,
    SENSOR_COUNT
} sensor_t;

typedef struct {
    uint8_t valve_states[VALVE_COUNT];
} valves_msg_t;

typedef struct {
    int16_t thermo1, thermo2, thermo3;
} temps_msg_t;

typedef struct
{
    uint16_t pressure1, pressure2, pressure3;
} press_msg_t;

typedef struct {
    uint8_t valve_states[VALVE_COUNT];
    uint16_t sensor_values[SENSOR_COUNT];
} hydra_data_t;

#endif // DATA_MODELS_H
```

## include/gpio.h
```c
// HYDRA GPIO abstraction layer
// Encapsulates Zephyr GPIO control for valves so higher layers don't touch
// low-level APIs directly.

#ifndef HYDRA_GPIO_H_
#define HYDRA_GPIO_H_

#include <stdbool.h>

// Initialize all HYDRA valve GPIOs as outputs, default inactive (closed)
// Returns 0 on success, <0 on error (last error if multiple)
int gpio_init_valves();

// Set valve GPIO by logical index (0..N-1) to active (open=true) or inactive
// Returns 0 on success, <0 on error
int gpio_set_valve(int id, bool open);

#endif // HYDRA_GPIO_H_
```

## include/pressures.h
```c
#ifndef PRESSURES_H
#define PRESSURES_H

#include <stdint.h>

#define N2_PRESSURE_MIN_BAR 0
#define N2_PRESSURE_MAX_BAR 250

#define N2O_PRESSURE_MIN_BAR 0
#define N2O_PRESSURE_MAX_BAR 100

int pressures_init(void);
void pressures_start(void);

int mv_to_mbar(int32_t mv, int32_t min_bar, int32_t max_bar);

#endif // PRESSURES_H
```

## include/temperatures.h
```c
#ifndef TEMPERATURES_H
#define TEMPERATURES_H

int temperatures_init(void);
void temperatures_start(void);

#endif // TEMPERATURES_H
```

## include/valves.h
```c
// Simple valve control API for HYDRA
// - Solenoid valves are toggled via GPIO (from board DTS node labels)
// - A servo valve helper (PWM angle) remains available for compatibility

#include <stdbool.h>
#include <stdint.h>

#include "pwm.h"

// Logical IDs for available HYDRA valves (as per inv2_hydra_rp2040.dts)
typedef enum {
	HYDRA_VALVE_SOL1 = 0,     // sol_valve_1
	HYDRA_VALVE_SOL2,         // sol_valve_2
	HYDRA_VALVE_SOL3,         // sol_valve_3
	HYDRA_VALVE_QDC_N2O,      // qdc_n2o
	HYDRA_VALVE_QDC_N2,       // qdc_n2
	HYDRA_VALVE_STEEL1,       // st_valve_1
	HYDRA_VALVE_STEEL2,       // st_valve_2
	HYDRA_VALVE_COUNT
} hydra_valve_t;

// Initialize all valve GPIOs as outputs, default closed (inactive)
int valves_init(void);

// Set a valve state: open = true to energize coil, false to close
int valve_set(hydra_valve_t id, bool open);

// Open a valve for a duration in milliseconds, then auto-close
int valve_open_ms(hydra_valve_t id, uint32_t ms);

// Query cached state
bool valve_is_open(hydra_valve_t id);

// PWM servo valve control 
void valve_pwm_set_angle(float angle);

// Configure a given DAC channel
bool valve_dac_configure(hydra_valve_t id, uint16_t value);
```

## src/gpio.c
```c
// HYDRA GPIO abstraction implementation
#include "gpio.h"

#include <zephyr/device.h>
#include <zephyr/drivers/gpio.h>
#include <zephyr/logging/log.h>

LOG_MODULE_REGISTER(hydra_gpio, LOG_LEVEL_INF);

// Map logical valves to device-tree nodes by label here, so higher layers
// don't need to include Zephyr GPIO headers.
static const struct gpio_dt_spec s_valve_specs[] = {
	GPIO_DT_SPEC_GET(DT_NODELABEL(sol_valve_1), gpios),
	GPIO_DT_SPEC_GET(DT_NODELABEL(sol_valve_2), gpios),
	GPIO_DT_SPEC_GET(DT_NODELABEL(sol_valve_3), gpios),
	GPIO_DT_SPEC_GET(DT_NODELABEL(qdc_n2o), gpios),
	GPIO_DT_SPEC_GET(DT_NODELABEL(qdc_n2), gpios),
	GPIO_DT_SPEC_GET(DT_NODELABEL(st_valve_1), gpios),
	GPIO_DT_SPEC_GET(DT_NODELABEL(st_valve_2), gpios),
};

#define HYDRA_VALVE_GPIO_COUNT (int)(sizeof(s_valve_specs) / sizeof(s_valve_specs[0]))

int gpio_init_valves()
{
	int rc = 0;
	for (int i = 0; i < HYDRA_VALVE_GPIO_COUNT; ++i) {
		const struct gpio_dt_spec *spec = &s_valve_specs[i];
		if (!device_is_ready(spec->port)) {
			LOG_ERR("Valve GPIO dev %d not ready", i);
			rc = -ENODEV;
			continue;
		}
		int r = gpio_pin_configure_dt(spec, GPIO_OUTPUT_INACTIVE);
		if (r) {
			LOG_ERR("Valve GPIO %d configure failed: %d", i, r);
			rc = r;
		}
	}
	if (rc == 0) {
		LOG_INF("Valve GPIOs initialized (%d)", HYDRA_VALVE_GPIO_COUNT);
	}
	return rc;
}

int gpio_set_valve(int id, bool open)
{
	if (id < 0 || id >= HYDRA_VALVE_GPIO_COUNT) {
		return -EINVAL;
	}
	const struct gpio_dt_spec *spec = &s_valve_specs[id];
	if (!device_is_ready(spec->port)) {
		return -ENODEV;
	}
	return gpio_pin_set_dt(spec, open ? 1 : 0);
}
```

## src/pressures.c
```c
#include "pressures.h"
#include <zephyr/kernel.h>
#include <zephyr/logging/log.h>

LOG_MODULE_REGISTER(pressures, LOG_LEVEL_INF);

#define PRESSURES_THREAD_STACK_SIZE 1024 // TODO: make KConfig
#define PRESSURES_THREAD_PRIORITY   5    // TODO: make KConfig

K_THREAD_STACK_DEFINE(pressures_thread_stack, PRESSURES_THREAD_STACK_SIZE);
static struct k_thread pressures_thread_data;

int pressures_init(void)
{
    // Initialization code for pressure sensors would go here
    LOG_INF("Pressure sensors initialized");
    return 0;
}

void pressures_thread_entry(void *p1, void *p2, void *p3)
{
    ARG_UNUSED(p1);
    ARG_UNUSED(p2);
    ARG_UNUSED(p3);

    LOG_INF("Pressure polling thread starting");

    while (1)
    {
        k_sleep(K_MSEC(1000));
        // Read pressures and publish to ZBUS
    }
}

void pressures_start(void)
{
    k_tid_t tid =
        k_thread_create(&pressures_thread_data, pressures_thread_stack,
                        K_THREAD_STACK_SIZEOF(pressures_thread_stack), pressures_thread_entry,
                        NULL, NULL, NULL, PRESSURES_THREAD_PRIORITY, 0, K_NO_WAIT);

    k_thread_name_set(tid, "pressures_thread");
    LOG_INF("Pressure monitoring started");
}

int mv_to_mbar(int mv, int32_t min_bar, int32_t max_bar)
{
    return (((mv * max_bar) / 10) + min_bar);
}
```

## src/pwm.c
```c
#include "pwm.h"

#define PWM_NODE DT_NODELABEL(pwm)

LOG_MODULE_REGISTER(peripherals, LOG_LEVEL_INF);

const struct device *pwm_dev;

void pwm_set_duty_cycle(uint32_t channel, uint32_t period_us, uint32_t pulse_us) {

    if (!device_is_ready(pwm_dev)) {
        LOG_INF("PWM not ready!\n");
        return;
    }

    int ret = pwm_set(pwm_dev, channel, PWM_USEC(period_us), PWM_USEC(pulse_us), 0);
    if (ret) {
        if(ret == -ENOTSUP) {
            LOG_INF("Requested period or pulse cycles are not supported. !\n");
            return;
        }
        LOG_INF("Error %d: failed to set pulse width!\n", ret); 
        return;
    }
    LOG_INF("Successfully set pwm period %d us and pulse %d us on channel %d\n", period_us, pulse_us, channel);
}

void pwm_init() {
    pwm_dev = DEVICE_DT_GET(PWM_NODE);

    if (!device_is_ready(pwm_dev)) {
        LOG_INF("PWM not ready!\n");
        return;
    } 
    LOG_INF("PWM initialized\n");
}
```

## src/temperatures.c
```c
#include "temperatures.h"
#include <zephyr/kernel.h>
#include <zephyr/logging/log.h>

LOG_MODULE_REGISTER(temperatures, LOG_LEVEL_INF);

#define THERMOS_THREAD_STACK_SIZE 1024 // TODO: make KConfig
#define THERMOS_THREAD_PRIORITY   5    // TODO: make KConfig

K_THREAD_STACK_DEFINE(thermos_thread_stack, THERMOS_THREAD_STACK_SIZE);
static struct k_thread thermos_thread_data;

int temperatures_init(void)
{
    // Initialization code for temperature sensors would go here
    LOG_INF("Temperature sensors initialized");
    return 0;
}

void thermos_thread_entry(void *p1, void *p2, void *p3)
{
    ARG_UNUSED(p1);
    ARG_UNUSED(p2);
    ARG_UNUSED(p3);

    LOG_INF("Thermocouple polling thread starting");

    while (1)
    {
        k_sleep(K_MSEC(1000));
        // Read temperatures and publish to ZBUS
    }
}

void temperatures_start(void)
{
    k_tid_t tid =
        k_thread_create(&thermos_thread_data, thermos_thread_stack,
                        K_THREAD_STACK_SIZEOF(thermos_thread_stack), thermos_thread_entry,
                        NULL, NULL, NULL, THERMOS_THREAD_PRIORITY, 0, K_NO_WAIT);

    k_thread_name_set(tid, "thermos_thread");
    LOG_INF("Temperature monitoring started");
}
```

## src/valves.c
```c
// HYDRA valves control implementation
#include "valves.h"

#include <string.h>
#include <zephyr/device.h>
#include <zephyr/kernel.h>
#include <zephyr/logging/log.h>
#include <zephyr/sys/util.h>
#include "gpio.h"
#include <zephyr/drivers/mfd/ad559x.h>

LOG_MODULE_REGISTER(valves, LOG_LEVEL_INF);

// Names aligned with GPIO mapping in hydra GPIO layer

// Human-friendly names aligned with s_valve_specs
static const char *const s_valve_names[HYDRA_VALVE_COUNT] = {
    "sol_valve_1",
    "sol_valve_2",
    "sol_valve_3",
    "qdc_n2o",
    "qdc_n2",
    "st_valve_1",
    "st_valve_2",
};

static bool s_open_state[HYDRA_VALVE_COUNT];

const struct device *mfd_dev = DEVICE_DT_GET(DT_ALIAS(dac));
bool dac_initialized = false;

int valves_init(void)
{
    memset(s_open_state, 0, sizeof(s_open_state));
    int rc = gpio_init_valves();
    if (rc == 0) {
        LOG_INF("Valves initialized (%d)", HYDRA_VALVE_COUNT);
    }

    if (mfd_dev == NULL)
    {
        LOG_ERR("Failed to initialize MFD device");

        return 0;
    }

    if (!device_is_ready(mfd_dev))
    {
        LOG_ERR("MFD device is not ready");
        return 0;
    }

    return rc;
}

int valve_set(hydra_valve_t id, bool open)
{
    if (id < 0 || id >= HYDRA_VALVE_COUNT) {
        return -EINVAL;
    }

    int r = gpio_set_valve((int)id, open);
    if (r == 0) {
        s_open_state[id] = open;
        LOG_DBG("Valve %u set to %s", id, open ? "OPEN" : "CLOSED");
    }
    return r;
}

int valve_toggle(hydra_valve_t id)
{
    if (id < 0 || id >= HYDRA_VALVE_COUNT) {
        return -EINVAL;
    }
    return valve_set(id, !s_open_state[id]);
}

int valve_toggle_by_name(const char *name)
{
    if (name == NULL) {
        return -EINVAL;
    }

    for (int i = 0; i < HYDRA_VALVE_COUNT; ++i) {
        if (strcmp(name, s_valve_names[i]) == 0) {
            return valve_toggle((hydra_valve_t)i);
        }
    }

    return -ENOENT;
}

bool valve_is_open(hydra_valve_t id)
{
    if (id < 0 || id >= HYDRA_VALVE_COUNT) return false;
    return s_open_state[id];
}

int valve_open_ms(hydra_valve_t id, uint32_t ms)
{
    int r = valve_set(id, true);
    if (r) return r;
    k_msleep(ms);
    return valve_set(id, false);
}

bool valve_dac_configure(hydra_valve_t id, uint16_t value)
{
    if (!dac_initialized)
    {
        LOG_ERR("can't configure DAC");
        return false;
    }

    LOG_INF("Configuring DAC %d with %d", id, value);
    return mfd_ad559x_write_dac_chan(mfd_dev, id, value) == 0;
}

// Sets the servo angle in degrees [0, 270]
void valve_pwm_set_angle(float angle)
{
    if (angle < 0) angle = 0;
    if (angle > 270) angle = 270;

    const int minPulse = 500;   // microseconds
    const int maxPulse = 2500;  // microseconds
    const int angleRange = 270;

    int pulseWidth = minPulse + (int)((angle / angleRange) * (maxPulse - minPulse));

    pwm_set_duty_cycle(5, 20000, pulseWidth); // Channel 5, 20ms period, pulse width calculated above
}
```
