## CMakeLists.txt
```
# SPDX-License-Identifier: Apache-2.0

cmake_minimum_required(VERSION 3.20.0)
find_package(Zephyr REQUIRED HINTS $ENV{ZEPHYR_BASE})
project(test_lora_integration)

file(GLOB app_sources src/main.c src/lora_fixture.h)

set(OBC_PATH "${CMAKE_CURRENT_SOURCE_DIR}/../../../../../invictus2/obc")
set(SERVICES_PATH "${OBC_PATH}/src/services/")

target_sources(app PRIVATE ${app_sources} ${SERVICES_PATH}/lora.c)

target_include_directories(app PRIVATE ${OBC_PATH}/include)
target_include_directories(app PRIVATE ${CMAKE_CURRENT_SOURCE_DIR}/include)
```

## prj.conf
```kconfig
CONFIG_ZTEST=y

CONFIG_LORA_SX128X=y

CONFIG_ZBUS=y
CONFIG_LOG=y
CONFIG_LOG_MODE_DEFERRED=y # default mode
CONFIG_LOG_MODE_IMMEDIATE=n
CONFIG_LOG_MODE_MINIMAL=n
```

## src/main.c
```c
#include "packets.h"
#include "services/lora.h"
#include "syscalls/kernel.h"
#include "zephyr/kernel.h"
#include "zephyr/logging/log.h"
#include "zephyr/sys/atomic.h"
#include "zephyr/ztest_assert.h"
#include <zephyr/ztest.h>
#include "zephyr/ztest_test.h"

#include <invictus2/drivers/sx128x_context.h>
#include "lora_fixture.h"
#include <stdint.h>

#include <zephyr/logging/log.h>
LOG_MODULE_REGISTER(lora_integration_tests, CONFIG_LORA_SX128X_LOG_LEVEL);

static bool radio_command_cmp(const struct generic_packet_s *lhs,
                              const struct generic_packet_s *rhs)
{
    return lhs->header.packet_version == rhs->header.packet_version &&
           lhs->header.sender_id == rhs->header.sender_id &&
           lhs->header.target_id == rhs->header.target_id &&
           lhs->header.command_id == rhs->header.command_id;
}

ZTEST_SUITE(lora_integration_test, NULL, test_fixture_setup, test_fixture_before,
            test_fixture_after, test_fixture_teardown);

ZTEST_F(lora_integration_test, test_lora_service_basic_data_reception_SUCCESS)
{
    // assert no data available before calback
    zassert_not_equal(k_sem_take(&fixture->ctx.data_available, K_NO_WAIT), 0);

    struct generic_packet_s cmd;
    cmd.header.packet_version = 0x12;
    cmd.header.sender_id = 0x02;
    cmd.header.target_id = 0x01;
    cmd.header.command_id = 0xFE;

    fake_sx128x_rf_reception((uint8_t *)&cmd, sizeof(cmd));

    // assert size of written data
    zassert_equal(fixture->ctx.rx_size, sizeof(struct generic_packet_s));
    // assert data available triggered after callback
    zassert_equal(k_sem_take(&fixture->ctx.data_available, K_NO_WAIT), 0);
}

ZTEST_F(lora_integration_test, test_lora_service_multiple_data_reception_SUCCESS)
{
    // assert no data available before calback
    zassert_not_equal(k_sem_take(&fixture->ctx.data_available, K_NO_WAIT), 0);

    struct generic_packet_s cmd;
    cmd.header.packet_version = 0x12;
    cmd.header.sender_id = 0x02;
    cmd.header.target_id = 0x01;
    cmd.header.command_id = 0xFE;

    fake_sx128x_rf_reception((uint8_t *)&cmd, sizeof(cmd));
    fake_sx128x_rf_reception((uint8_t *)&cmd, sizeof(cmd));

    // assert size of written data
    zassert_equal(fixture->ctx.rx_size, 2 * sizeof(struct generic_packet_s));
    // assert no data available triggered after callback
    zassert_equal(k_sem_take(&fixture->ctx.data_available, K_NO_WAIT), 0);
}

ZTEST_F(lora_integration_test, test_lora_service_handle_packet_SUCCESS)
{
    lora_service_start();

    struct generic_packet_s cmd;
    cmd.header.packet_version = 0x12;
    cmd.header.sender_id = 0x02;
    cmd.header.target_id = 0x01;
    cmd.header.command_id = 0xFE;

    fake_sx128x_rf_reception((uint8_t *)&cmd, sizeof(cmd));
    k_sleep(K_MSEC(100));

    zassert_equal(g_fixture->number_of_received_messages, 1);
    zassert_true(radio_command_cmp(&cmd, &g_fixture->received_messages[0]));

    // stop lora service
    atomic_set(&g_fixture->stop_signal, 1);
    // wait some time for thread to finish
    k_sleep(K_MSEC(100));
}

ZTEST_F(lora_integration_test, test_lora_service_handle_multiple_packet_SUCCESS)
{
    lora_service_start();

    struct generic_packet_s cmd;
    cmd.header.packet_version = 0x12;
    cmd.header.sender_id = 0x02;
    cmd.header.target_id = 0x01;
    cmd.header.command_id = 0xFE;

    struct generic_packet_s cmd2 = cmd;
    cmd2.header.command_id = 0xAA;

    fake_sx128x_rf_reception((uint8_t *)&cmd, sizeof(cmd));
    k_sleep(K_MSEC(10));
    fake_sx128x_rf_reception((uint8_t *)&cmd2, sizeof(cmd2));
    k_sleep(K_MSEC(100));

    zassert_equal(g_fixture->number_of_received_messages, 2);
    zassert_true(radio_command_cmp(&cmd, &g_fixture->received_messages[0]));
    zassert_true(radio_command_cmp(&cmd2, &g_fixture->received_messages[1]));

    // stop lora service
    atomic_set(&g_fixture->stop_signal, 1);
    // wait some time for thread to finish
    k_sleep(K_MSEC(100));
}
```

## src/lora_fixture.h
```c
#ifndef OBC_TESTS_LORA_H
#define OBC_TESTS_LORA_H

#include <stdlib.h>
#include <stdbool.h>
#include "packets.h"
#include "zephyr/kernel.h"
#include "zephyr/sys/atomic.h"
#include "zephyr/ztest_assert.h"
#include <invictus2/drivers/sx128x_context.h>
#include "services/lora.h"
#include "zephyr/zbus/zbus.h"

struct lora_integration_test_fixture
{
    atomic_t stop_signal;
    lora_context_t ctx;
    struct generic_packet_s received_messages[100];
    size_t number_of_received_messages;
};

// --- Radio Commands from Ground Station ---
ZBUS_CHAN_DEFINE(chan_radio_cmds,         /* Channel Name */
                 struct generic_packet_s, /* Message Type */
                 NULL,                    /* Validator Func */
                 NULL,                    /* User Data */
                 ZBUS_OBSERVERS_EMPTY,    /* Observers */
                 ZBUS_MSG_INIT(0)         /* Initial Value */
)

// FIXME this should be in a proper header file
extern bool fake_sx128x_is_rx_callback_set();
extern void fake_sx128x_rf_reception(uint8_t *, size_t);

// Hack to access fixture on callbacks
static struct lora_integration_test_fixture *g_fixture = NULL;

static void on_new_message(const struct zbus_channel *chan)
{
    if (g_fixture == NULL)
    {
        return;
    }

    if (g_fixture->number_of_received_messages >= sizeof(g_fixture->received_messages))
    {
        return;
    }

    g_fixture->received_messages[g_fixture->number_of_received_messages] =
        *(struct generic_packet_s *)zbus_chan_msg(&chan_radio_cmds);
    g_fixture->number_of_received_messages++;
}

ZBUS_LISTENER_DEFINE(radio_command_listener, on_new_message);
ZBUS_CHAN_ADD_OBS(chan_radio_cmds, radio_command_listener, 4);

static void *test_fixture_setup(void)
{
    zassert_is_null(g_fixture);
    struct lora_integration_test_fixture *fixture =
        malloc(sizeof(struct lora_integration_test_fixture));
    zassert_not_null(fixture, NULL);

    g_fixture = fixture;
    zassert_equal(g_fixture, fixture, "Invalid fixture setup");

    return fixture;
}

static void test_fixture_before(void *f)
{
    zassert_not_null(g_fixture);

    struct lora_integration_test_fixture *fixture = (struct lora_integration_test_fixture *)f;
    zassert_equal(g_fixture, fixture, "Invalid fixture setup");

    // reset any previously set callback
    fixture->stop_signal = ATOMIC_INIT(0);
    fixture->ctx.stop_signal = &fixture->stop_signal;
    fixture->number_of_received_messages = 0;

    lora_service_setup(&fixture->ctx);

    // assert that lora service configured a callback on setup
    zassert_true(fake_sx128x_is_rx_callback_set());
}

static void test_fixture_after(void *f)
{
    zassert_not_null(g_fixture);

    struct lora_integration_test_fixture *fixture = (struct lora_integration_test_fixture *)f;
    zassert_equal(g_fixture, fixture, "Invalid fixture setup");

    // make thread stop
    atomic_set(&fixture->stop_signal, 1);

    // give some time for thread to stop
    k_sleep(K_MSEC(100));
}

static void test_fixture_teardown(void *f)
{
    g_fixture = NULL;
    free(f);
}

#endif
```
